/* SPDX-License-Identifier: Apache-2.0 */

&spi1 {
	status = "ok";
	cs-gpios = <&gpioa 4 0>;

	at86rf2xx@0 {
		compatible = "atmel,at86rf2xx";
		reg = <0x0>;
		spi-max-frequency = <7000000>;
		status = "ok";
		reset-gpios = <&gpiob 0 0>;
		irq-gpios = <&gpiob 1 0>;
		sleep-gpios = <&gpiob 2 0>;
	};
};
