## boards/arm/stm32l4_sx1276/Kconfig.board
```kconfig
# Kconfig - STM32L4 SX1276 board configuration
#
# Copyright (c) 2020 M2I Corporation
#
# SPDX-License-Identifier: Apache-2.0
#

config BOARD_STM32L4_SX1276
	bool "STM32L4 SX1276"
	depends on SOC_STM32L433XX
```

## boards/arm/stm32l4_sx1276/Kconfig.defconfig
```kconfig
# Kconfig - STML4 SX1276 board configuration
#
# Copyright (c) 2020 M2I Corporation
#
# SPDX-License-Identifier: Apache-2.0
#

if BOARD_STM32L4_SX1276

config BOARD
	default "stm32l4_sx1276"

if UART_CONSOLE

config UART_1
	default y

endif # UART_CONSOLE

endif # BOARD_STM32L4_SX1276
```

## drivers/adc/Kconfig.stm32
```kconfig
# Kconfig - ADC configuration options

#
# Copyright (c) 2019 Intel Corporation
# Copyright (c) 2019 Endre Karlson
#
# SPDX-License-Identifier: Apache-2.0
#

menuconfig ADC_STM32
	bool "STM32 ADC driver"
	depends on SOC_FAMILY_STM32
	help
		Enable the driver implementation for the stm32xx ADC

if ADC_STM32

	menu ADC_0
		config ADC0_CHAN0
			bool "channel 0 (PA0)"
			default n
			depends on ADC_0
			help
			  Enables ADC channel 0 at pin PA0

		config ADC0_CHAN1
			bool "channel 1 (PA1)"
			default n
			depends on ADC_0
			help
			  Enables ADC channel 1 at pin PA1

		config ADC0_CHAN2
			bool "channel 2 (PA2)"
			default n
			depends on ADC_0
			help
			  Enables ADC channel 2  at pin PA2

		config ADC0_CHAN3
			bool "channel 3 (PA3)"
			default n
			depends on ADC_0
			help
			  Enables ADC channel 3 at pin PA3

		config ADC0_CHAN4
			bool "channel 4 (PA4)"
			default n
			depends on ADC_0
			help
			  Enables ADC channel 4 at pin PA4

		config ADC0_CHAN5
			bool "channel 5 (PA5)"
			default n
			depends on ADC_0
			help
			  Enables ADC channel 5 at pin PA5

		config ADC0_CHAN6
			bool "channel 6 (PA6)"
			default n
			depends on ADC_0
			help
			  Enables ADC channel 6 at pin PA6

		config ADC0_CHAN7
			bool "channel 7 (PA7)"
			default n
			depends on ADC_0
			help
			  Enables ADC channel 7 at pin PA7

		config ADC0_CHAN8
			bool "channel 8 (PB0)"
			default n
			depends on ADC_0
			help
			  Enables ADC channel 8 at pin PB0

		config ADC0_CHAN9
			bool "channel 9 (PB1)"
			default n
			depends on ADC_0
			help
			  Enables ADC channel 9 at pin PB1

		config ADC0_CHAN10
			bool "channel 10 (PC0)"
			default n
			depends on ADC_0
			help
			  Enables ADC channel 10 at pin PC0

		config ADC0_CHAN11
			bool "channel 11 (PC1)"
			default n
			depends on ADC_0
			help
			  Enables ADC channel 11  at pin PC1

		config ADC0_CHAN12
			bool "channel 12 (PC2)"
			default n
			depends on ADC_0
			help
			  Enables ADC channel 12 at pin PC2

		config ADC0_CHAN13
			bool "channel 13 (PC3)"
			default n
			depends on ADC_0
			help
			  Enables ADC channel 13 at pin PC3

		config ADC0_CHAN14
			bool "channel 14 (PC4)"
			default n
			depends on ADC_0
			help
			  Enables ADC channel 14 at pin PC4

		config ADC0_CHAN15
			bool "channel 15 (PC5)"
			default n
			depends on ADC_0
			help
			  Enables ADC channel 15 at pin PC5

		config ADC0_CHAN_TEMP
			bool "channel 16 (temp)"
			default n
			depends on ADC_0
			help
				Enables ADC temperature channel

		config ADC0_CHAN_VREFINT
			bool "channel 17 (Vrefint)"
			default n
			depends on ADC_0
			help
				Enables ADC internal voltage reference channel

		config ADC0_CHAN_VABT
			bool "channel 18 (VBat)"
			default n
			depends on ADC_0
			depends on SOC_SERIES_STM32F4X
			help
				Enables ADC voltage battery channel
	endmenu

endif # ADC_STM32
```

## drivers/iio/Kconfig
```kconfig
#
# Copyright (c) 2019 Kwon Tae-young <tykwon@m2i.co.kr>
#
# SPDX-License-Identifier: Apache-2.0
#

# Top-level configuration file for Industrial I/O drivers.

menuconfig IIO
	bool "Industrial I/O support"
	select HAS_IIO_DRIVERS
	help
	  Include Industrial I/O drivers in the system configuration.

if IIO

module = IIO
module-str = iio
source "subsys/logging/Kconfig.template.log_config"

config IIO_INIT_PRIORITY
	int "Industrial I/O initialization priority"
	default 90
	help
	  System initialization priority for Industrial I/O drivers.

source "drivers/iio/Kconfig.sn65hvs885"

endif # IIO
```

## drivers/iio/Kconfig.adc121s051
```kconfig
#
# Copyright (c) 2019 Kwon Tae-young <tykwon@m2i.co.kr>
#
# SPDX-License-Identifier: Apache-2.0
#

menuconfig IIO_ADC121S051
	bool "TI ADC121S051 driver"
	select HAS_IIO_ADC121S051
	depends on SPI
	depends on GPIO
	help
	  Enable Industrial I/O driver for TI ADC121S051.
```

## drivers/iio/Kconfig.drv8804
```kconfig
#
# Copyright (c) 2019 Kwon Tae-young <tykwon@m2i.co.kr>
#
# SPDX-License-Identifier: Apache-2.0
#

menuconfig IIO_DRV8804
	bool "TI DRV8804 driver"
	select HAS_IIO_DRV8804
	depends on SPI
	depends on GPIO
	help
	  Enable Industrial I/O driver for TI DRV8804.
```

## drivers/iio/Kconfig.sn65hvs885
```kconfig
#
# Copyright (c) 2019 Kwon Tae-young <tykwon@m2i.co.kr>
#
# SPDX-License-Identifier: Apache-2.0
#

menuconfig IIO_SN65HVS885
	bool "TI SN65HVS885 driver"
	select HAS_IIO_SN65HVS885
	depends on SPI
	depends on GPIO
	help
	  Enable Industrial I/O driver for TI SN65HVS885.
```

## drivers/sensor/pct2075/Kconfig
```kconfig
# PCT2075 temperature sensor configuration options

# Copyright (c) 2020 Kwon Tae-young <tykwon@m2i.co.kr>
# SPDX-License-Identifier: Apache-2.0

config PCT2075
	bool "PCT2075 Temperature Sensor"
	depends on (I2C && HAS_DTS_I2C)
	help
	  Enable driver for PCT2075 temperature sensors.
```

## dts/bindings/gpio/ti,drv8804.yaml
```yaml
#
# Copyright (c) 2019 Kwon Tae-young <tykwon@m2i.co.kr>
#
# SPDX-License-Identifier: Apache-2.0
#
---
title: TI DRV8804 Digital-Output

description: >
    This is a representation of the TI DRV8804 Digital-Output.

compatible: "ti,drv8804"

include: spi-device.yaml

properties:
    reset-gpios:
      type: phandle-array
      required: true

    nfault-gpios:
      type: phandle-array
      required: true
...
```

## dts/bindings/gpio/ti,sn65hvs885.yaml
```yaml
#
# Copyright (c) 2019 Kwon Tae-young <tykwon@m2i.co.kr>
#
# SPDX-License-Identifier: Apache-2.0
#
---
title: TI SN65HVS885 Digital-Input

description: >
    This is a representation of the TI SN65HVS885 Digital-Input.

compatible: "ti,sn65hvs885"

include: spi-device.yaml

properties:
    load-gpios:
      type: phandle-array
      required: true

    hot-gpios:
      type: phandle-array
      required: true

    miso-switch-gpios:
      type: phandle-array
      required: true
...
```

## dts/bindings/ieee802154/atmel,at86rf2xx.yaml
```yaml
#
# Copyright (c) 2019, Kwon Tae-young <tykwon@m2i.co.kr>
#
# SPDX-License-Identifier: Apache-2.0
#
---
title: AT86RF2XX 2.4GHz Transceiver
version: 0.1

description: >
    This is a representation of the AT86RF2XX wireless transceiver.

inherits:
    !include spi-device.yaml

properties:
    compatible:
      type: string
      category: required
      description: compatible strings
      constraint: "atmel,at86rf2xx"

    reset-gpios:
      type: compound
      category: optional
      generation: define, use-prop-name

    irq-gpios:
      type: compound
      category: optional
      generation: define, use-prop-name

    sleep-gpios:
      type: compound
      category: optional
      generation: define, use-prop-name
...
```

## dts/bindings/iio/adc/ti,adc121s051.yaml
```yaml
#
# Copyright (c) 2019 Kwon Tae-young <tykwon@m2i.co.kr>
#
# SPDX-License-Identifier: Apache-2.0
#
---
title: TI ADC121S051 ADC

description: >
    This is a representation of the TI ADC121S051 ADC.

compatible: "ti,adc121s051"

include: spi-device.yaml
...
```

## dts/bindings/lora/semtech,sx1276.yaml
```yaml
#
# Copyright (c) 2019, Manivannan Sadhasivam
#
# SPDX-License-Identifier: Apache-2.0
#
---
title: Semtech SX1276 LoRa Modem

description: >
    This is a representation of the SX1276 LoRa Modem

compatible: "semtech,sx1276"

include: spi-device.yaml

properties:
    reset-gpios:
      type: phandle-array
      required: true

    dio-gpios:
      type: phandle-array
      required: true

...
```

## dts/bindings/sensor/nxp,pct2075.yaml
```yaml
# Copyright (c) 2020 Kwon Tae-young <tykwon@m2i.co.kr>
# SPDX-License-Identifier: Apache-2.0

description: NXP PCT2075 temperature sensor

compatible: "nxp,pct2075"

include: i2c-device.yaml
```

## samples/drivers/rf/spi_at86rf2xx/sample.yaml
```yaml
sample:
  name: SPI AT86RF2XX RF Tranceiver sample
tests:
  sample.driver.spi_fujitsu_fram:
    platform_whitelist: stm32f4_disco
    tags: drivers rf
    harness: rf
```

## samples/nfc/nfc_hello/boards/stm32f4_disco.conf
```kconfig
CONFIG_SERIAL=y
CONFIG_STDOUT_CONSOLE=y
CONFIG_UART_INTERRUPT_DRIVEN=y
CONFIG_UART_1=y
```
